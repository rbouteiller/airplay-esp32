## main/Kconfig.projbuild
```kconfig
menu "AP2 RAW RX Debug"
    config DEFAULT_AP_SSID
        string "Setup AP SSID"
        default "ESP32-AirPlay-Setup"
    config DEFAULT_AP_PASSWORD
        string "Setup AP password"
        default ""
    config DEFAULT_AP_CHANNEL
        int "Setup AP channel"
        default 1
        range 1 13
    config WIFI_PREFER_5GHZ
        bool "Prefer 5 GHz when available"
        default n
    config WIFI_PREFER_5GHZ_MIN_RSSI
        int "Minimum 5 GHz RSSI"
        default -75
        range -95 -30
        depends on WIFI_PREFER_5GHZ
    config ENABLE_AIRPLAY_ARTWORK
        bool "Advertise artwork support"
        default n
endmenu

menu "I2S Playout (V22)"
    config I2S_SCK_IO
        int "I2S MCLK GPIO"
        default 8
    config I2S_BCK_IO
        int "I2S BCLK GPIO"
        default 11
    config I2S_WS_IO
        int "I2S LRCK/WS GPIO"
        default 13
    config I2S_DO_IO
        int "I2S DATA OUT GPIO"
        default 12
    config AP2_PLAYOUT_TEST_OFFSET_US
        int "AirPlay playout test offset (us; positive advances ESP audio)"
        default 0
        range -200000 200000
        help
            Diagnostic-only presentation offset for multiroom testing.
            Positive values advance the selected RTP content relative to the
            physical I2S sample boundary; negative values delay it. V22 applies
            this at the one-enable sample-alignment boundary. Keep 0 for normal
            use. Nonzero values are diagnostic/manual trim only.
endmenu
```

## sdkconfig.defaults
```kconfig
# Minimal AP2 RAW RX debug defaults
CONFIG_SPIRAM=y
CONFIG_SPIRAM_SPEED_80M=y
CONFIG_FREERTOS_TASK_CREATE_ALLOW_EXT_MEM=y

# ESP32-S3 N8R8 uses quad flash + octal PSRAM.
CONFIG_ESPTOOLPY_FLASHMODE_DIO=y
CONFIG_ESPTOOLPY_FLASHMODE="dio"
CONFIG_ESPTOOLPY_FLASHFREQ_80M=y

CONFIG_ESP_DEFAULT_CPU_FREQ_MHZ_240=y
CONFIG_ESP_DEFAULT_CPU_FREQ_MHZ=240

CONFIG_ESP_WIFI_STATIC_RX_BUFFER_NUM=10
CONFIG_ESP_WIFI_DYNAMIC_RX_BUFFER_NUM=32
CONFIG_ESP_WIFI_DYNAMIC_TX_BUFFER_NUM=32
CONFIG_LIBSODIUM_USE_MBEDTLS_SHA=n
CONFIG_MDNS_MAX_SERVICES=4
CONFIG_MDNS_TASK_CREATE_FROM_SPIRAM=y
CONFIG_MDNS_MEMORY_ALLOC_SPIRAM=y
CONFIG_MBEDTLS_DEFAULT_MEM_ALLOC=y
CONFIG_LWIP_MAX_SOCKETS=24
CONFIG_LWIP_SO_RCVBUF=y
CONFIG_LOG_DEFAULT_LEVEL_INFO=y
CONFIG_LOG_DEFAULT_LEVEL=3
CONFIG_LOG_COLORS=y
CONFIG_PARTITION_TABLE_CUSTOM=y
CONFIG_PARTITION_TABLE_CUSTOM_FILENAME="partitions.csv"
CONFIG_COMPILER_OPTIMIZATION_PERF=y
CONFIG_SPIRAM_MALLOC_ALWAYSINTERNAL=1024
CONFIG_HTTPD_WS_SUPPORT=y
```

## sdkconfig.defaults.esp32s3
```kconfig
# ESP32-S3 N8R8
CONFIG_ESPTOOLPY_FLASHSIZE_8MB=y
CONFIG_ESPTOOLPY_FLASHSIZE="8MB"
CONFIG_SPIRAM_MODE_OCT=y
# CONFIG_SPIRAM_MODE_QUAD is not set
CONFIG_I2S_SCK_IO=8
CONFIG_I2S_BCK_IO=11
CONFIG_I2S_WS_IO=13
CONFIG_I2S_DO_IO=12
```
