## components/dac/Kconfig
```kconfig
menu "DAC Configuration"

    config DAC_TAS57XX
        bool "TI TAS57xx (TAS5754/TAS5756)"
        default n
        help
            Build the TI TAS5754M / TAS5756M DAC/amplifier driver.
            The board must register it at runtime via dac_register().

    config DAC_TAS58XX
        bool "TI TAS58xx (TAS5825M)"
        default n
        help
            Build the TI TAS5825M DAC/amplifier driver.
            The board must register it at runtime via dac_register().

    config DAC_ES8311
        bool "ESS ES8311 (stereo audio codec)"
        default n
        help
            Build the ES8311 stereo audio codec driver.
            The board must register it at runtime via dac_register().

    config DAC_PCM51XX
        bool "TI PCM512x (PCM5121/PCM5122/PCM5141/PCM5142)"
        default n
        help
            Build the TI PCM512x I2C-controlled DAC driver (Sonocotta
            HiFi-ESP32-Plus / Amped-ESP32-Plus). The board must register it
            at runtime via dac_register().

    config DAC_ES8388
        bool "ESS ES8388 (stereo audio codec)"
        default n
        help
            Build the ES8388 stereo audio codec driver (e.g. AI-Thinker
            ESP32-A1S Audio Kit). The board must register it at runtime via
            dac_register().

    config DAC_CONTROLS_VOLUME
        bool
        default y if DAC_TAS57XX || DAC_TAS58XX || DAC_ES8311 || DAC_ES8388 || DAC_PCM51XX
        help
            Hidden option. Set automatically when a hardware DAC driver is enabled.
            When true, the DAC handles volume control and software attenuation
            is skipped in the audio output path.

    choice DAC_PLAIN_DELAY
        prompt "Plain I2S DAC output delay"
        depends on AUDIO_OUTPUT_I2S
        default DAC_PLAIN_DELAY_UNKNOWN
        help
            The group delay of a DAC that has no driver to report one, such
            as a PCM5102A board wired straight to the I2S pins. The receiver
            starts every sample that much early, so the sound leaves the DAC
            on time. A DAC driver that reports its own delay (PCM512x)
            overrides this. Every figure is the datasheet's; anything after
            the DAC (an amplifier with DSP, an AV receiver) is left to the
            output latency trim in the web UI.

        config DAC_PLAIN_DELAY_PCM510X_NORMAL
            bool "TI PCM5100A/5101A/5102A, normal filter (FLT low): 22 samples"
            help
                The usual strapping. The purple GY-PCM5102 board in the "Check
                the DAC board" photo (docs/assets/PCM5102A.png, shown in
                docs/getting-started/shopping-list.md) has bridge 1 (FLT) on
                L, and Sonocotta's PCM5100A boards (HiFi-ESP32, Amped-ESP32,
                HiFi-/Amped-Esparagus) tie FLT to GND. TI SLAS859C, Tables
                4-6: filter group delay 22 tS; the filter summary in section
                8.5 says 20 tS. 22 is used: it is the per-mode figure.

        config DAC_PLAIN_DELAY_PCM510X_LOW_LATENCY
            bool "TI PCM5100A/5101A/5102A, low-latency filter (FLT high): 3.5 samples"
            help
                FLT strapped high. TI SLAS859C, Tables 7-9 and section 8.5:
                3.5 tS.

        config DAC_PLAIN_DELAY_CS434X
            bool "Cirrus CS4344/CS4345/CS4348: 10 samples"
            help
                Cirrus DS613F2, page 6: group delay 10/Fs in single-speed
                mode (up to 50 kHz), 5/Fs double speed, 2.5/Fs quad speed.

        config DAC_PLAIN_DELAY_CUSTOM
            bool "Custom"

        config DAC_PLAIN_DELAY_UNKNOWN
            bool "Unknown (0)"
            help
                Nothing is compensated for the DAC. Its delay, typically well
                under a millisecond, can still be calibrated away with the
                output latency trim.
    endchoice

    config DAC_PLAIN_DELAY_CUSTOM_Q4
        int "Custom DAC output delay, in 1/16 sample periods"
        depends on DAC_PLAIN_DELAY_CUSTOM
        range 0 16384
        default 0
        help
            The DAC's group delay in sixteenths of a sample period at the
            I2S rate: 22 samples is 352, 3.5 samples is 56.

endmenu
```

## config/sdkconfig.defaults.esp32s31
```kconfig
CONFIG_BOARD_ESP32S31_GENERIC=y

# Flash layout (8 MB)
CONFIG_ESPTOOLPY_FLASHSIZE_8MB=y
CONFIG_ESPTOOLPY_FLASHSIZE="8MB"
CONFIG_SPIRAM_MODE_OCT=y
CONFIG_SPIRAM_SPEED_200M=y

# Enable software EQ
CONFIG_SOFTWARE_EQ=y

# GPIO defaults
CONFIG_LED_RGB_GPIO=60
CONFIG_I2S_SCK_IO=2
CONFIG_I2S_BCK_IO=3
CONFIG_I2S_WS_IO=4
CONFIG_I2S_DO_IO=5
```
