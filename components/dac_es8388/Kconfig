## components/dac_es8388/Kconfig
```kconfig
if DAC_ES8388

    config ES8388_MAX_VOLUME
        int "Maximum DAC volume (dB)"
        range -96 0
        default -20
        help
            Maximum volume level in dB that corresponds to AirPlay volume 0 dB.
            The ES8388 master DAC volume register range is 0 dB to -96 dB.
            A value of -20 means AirPlay full volume maps to -20 dB on the DAC
            (this board also has an external amp stage after the codec, so
            0 dB here would usually be uncomfortably loud).

endif # DAC_ES8388
```

## components/dac_pcm51xx/Kconfig
```kconfig
if DAC_PCM51XX

    config PCM51XX_MAX_VOLUME
        int "Maximum DAC volume (dB)"
        range -100 0
        default 0
        help
            Digital volume in dB that corresponds to AirPlay volume 0 dB.
            The PCM512x digital volume register runs from 0 dB down to
            -103 dB in 0.5 dB steps; the boost range above 0 dB is not used.
            Line-level boards normally leave this at 0.

    config PCM51XX_I2C_ADDR
        hex "PCM512x I2C address"
        range 0x4C 0x4F
        default 0x4D
        help
            7-bit I2C address selected by the ADR1/ADR2 straps.
            Sonocotta HiFi-ESP32-Plus and Amped-ESP32-Plus use 0x4D.

    config PCM51XX_ANALOG_GAIN_MINUS_6DB
        bool "Use -6 dB analog gain (1V RMS output)"
        default n
        help
            The PCM512x analog output stage can run at 0 dB (2V RMS, the
            chip's default) or -6 dB (1V RMS). Enable this to match a
            board designed around the lower, 1V RMS output level.

endif # DAC_PCM51XX
```

## components/dac_tas57xx/Kconfig
```kconfig
if DAC_TAS57XX

    config TAS57XX_MAX_VOLUME
        int "Maximum DAC volume (dB)"
        range -100 0
        default -30
        help
            Maximum volume level in dB that corresponds to AirPlay volume 0 dB.
            The usable P0-R61/R62 range is 0 dB to -103 dB; the boost half of
            the register (up to +24 dB) is deliberately not used.
            A value of -30 means AirPlay full volume maps to -30 dB on the DAC.

    config TAS57XX_FORCE_BCK_PLL
        bool "Always derive the PLL from BCK"
        default n
        help
            By default the driver puts the PLL on MCLK when it detects one on
            the SCK pin, and falls back to BCK otherwise. Set this to keep the
            PLL on BCK even when MCLK is present, so the clock-error masks that
            a no-MCLK board needs are exercised on a board that has one.

            Only useful for testing whether a flow runs without MCLK wired.

    config TAS57XX_FAULT_MONITOR
        bool "Poll and log amplifier fault status"
        default n
        help
            Periodically read the TAS57xx read-only status registers over I2C
            and log power-state transitions, output short detection, auto-mute
            and SPK_MUTE (external undervoltage) events.

            Useful for diagnosing intermittent audio loss on boards where the
            SPK_FAULT pin is not wired to the ESP32, since over-temperature,
            over-current and DC-offset faults are otherwise invisible to
            software. Costs a few I2C reads per interval.

    config TAS57XX_FAULT_POLL_MS
        int "Fault poll interval (ms)"
        depends on TAS57XX_FAULT_MONITOR
        range 100 60000
        default 1000

endif # DAC_TAS57XX
```

## components/dac_tas58xx/Kconfig
```kconfig
if DAC_TAS58XX

    config TAS58XX_ANALOG_GAIN_UNKNOWN_SUPPLY
        int "Analog gain while the supply is unknown (dB)"
        range -16 0
        default -10
        help
            The amplifier's analog gain follows its supply, as a USB-PD
            trigger agrees it or a TAS5825M measures it. Until the board knows
            the supply it plays at this gain. 0 dB is 29.5 V peak at digital
            full scale; -10 dB is 9.3 V. -16 is the 5 V level, which plays at
            the bottom of the range, -15.5 dB.

    config TAS58XX_FORCE_PBTL
        bool "Force PBTL (mono) mode on primary amplifier"
        default n
        help
            Force the primary TAS58xx amplifier into PBTL (mono) mode.
            When enabled, the PBTL setting cannot be changed from the web UI.
            Only available for TAS5825M/TAS5805M (not other DACs).
            The amplifier must be wired for PBTL mode in hardware.

            Set it for a board that ties OUT_A+ to OUT_A- and OUT_B+ to
            OUT_B- in copper, such as the Louder-ESP32-Mini. That wiring must
            never run as a stereo pair: each tied pair of half-bridges would
            be driven against each other. A bridged TAS5805M plays the left
            I2S channel, so the output channel mode defaults to mono (L+R)
            on such a board.

endif # DAC_TAS58XX
```

## components/husb238a/Kconfig
```kconfig
menu "USB-PD trigger (HUSB238A)"

    config HUSB238A
        bool "HUSB238A USB-PD trigger on the DAC's I2C bus"
        depends on DAC_TAS58XX
        default n
        help
            Look for a Hynetek HUSB238A, strapped for I2C at 0x42, on the
            DAC's bus, and ask the USB-C charger for a higher voltage than
            the 5 V every port gives. The amplifier runs from that supply,
            so a higher one lets it play louder before it clips, and full
            volume is raised to use it.

            Strapped for I2C, the chip asks for nothing until it is told to,
            and forgets on every power loss, so it is asked again on every
            boot, before the amplifier comes up. A board without the chip
            does not answer at its address and is left alone, so one build
            can serve boards with and without it, such as the 42 mm and the
            55 mm Louder-ESP32-Mini.

    config HUSB238A_DEFAULT_VOLTS
        int "Voltage to ask for until one is chosen on the settings page"
        depends on HUSB238A
        range 5 20
        default 5
        help
            One of the fixed USB-PD offers: 5, 9, 12, 15 or 20 V. Anything
            else falls to the highest of those below it, and so does a
            voltage the charger does not offer.

    config HUSB238A_MAX_VOLTS
        int "Highest voltage the board's supply rail is rated for"
        depends on HUSB238A
        range 5 20
        default 20
        help
            Never asked for, whatever is chosen. The chip can also negotiate
            the 28-48 V EPR offers; those are never asked for at all.

endmenu
```

## config/sdkconfig.defaults.amped-esp32
```kconfig
# Amped-ESP32 defaults (ESP32, PCM5100 DAC + TPA3110/TPA3128 amp — no I2C,
# active-high UNMUTE pin)
CONFIG_BOARD_AMPED_ESP32=y
CONFIG_ESPTOOLPY_FLASHSIZE_8MB=y
CONFIG_ESPTOOLPY_FLASHSIZE="8MB"

# GPIO config
CONFIG_I2S_BCK_IO=26
CONFIG_I2S_WS_IO=25
CONFIG_I2S_DO_IO=22
CONFIG_DAC_ENABLE_GPIO=13

# W5500 Ethernet
CONFIG_ETH_W5500_ENABLED=y
CONFIG_ETH_USE_SPI_ETHERNET=y
CONFIG_ETH_SPI_ETHERNET_W5500=y
CONFIG_SPI_CLK_GPIO=18
CONFIG_SPI_MOSI_GPIO=23
CONFIG_SPI_MISO_GPIO=19
CONFIG_ETH_W5500_CS_GPIO=5
CONFIG_ETH_W5500_INT_GPIO=35
CONFIG_ETH_W5500_RST_GPIO=14

# SPI Display
CONFIG_DISPLAY_ENABLED=y
CONFIG_DISPLAY_DRIVER_SH1106=y
CONFIG_DISPLAY_BUS_SPI=y
CONFIG_DISPLAY_SPI_CLK=18
CONFIG_DISPLAY_SPI_MOSI=23
CONFIG_DISPLAY_SPI_CS=15
CONFIG_DISPLAY_SPI_DC=4
CONFIG_DISPLAY_SPI_RST=32
```

## config/sdkconfig.defaults.loud-esp32
```kconfig
# Loud-ESP32 defaults (ESP32, MAX98357A — I2S amp, active-high SD_MODE enable, no I2C)
CONFIG_BOARD_LOUD_ESP32=y
CONFIG_ESPTOOLPY_FLASHSIZE_8MB=y
CONFIG_ESPTOOLPY_FLASHSIZE="8MB"

# GPIO config
CONFIG_I2S_BCK_IO=26
CONFIG_I2S_WS_IO=25
CONFIG_I2S_DO_IO=22
CONFIG_DAC_ENABLE_GPIO=13

# W5500 Ethernet
CONFIG_ETH_W5500_ENABLED=y
CONFIG_ETH_USE_SPI_ETHERNET=y
CONFIG_ETH_SPI_ETHERNET_W5500=y
CONFIG_SPI_CLK_GPIO=18
CONFIG_SPI_MOSI_GPIO=23
CONFIG_SPI_MISO_GPIO=19
CONFIG_ETH_W5500_CS_GPIO=5
CONFIG_ETH_W5500_INT_GPIO=35
CONFIG_ETH_W5500_RST_GPIO=14

# SPI Display
CONFIG_DISPLAY_ENABLED=y
CONFIG_DISPLAY_DRIVER_SH1106=y
CONFIG_DISPLAY_BUS_SPI=y
CONFIG_DISPLAY_SPI_CLK=18
CONFIG_DISPLAY_SPI_MOSI=23
CONFIG_DISPLAY_SPI_CS=15
CONFIG_DISPLAY_SPI_DC=4
CONFIG_DISPLAY_SPI_RST=32
```
