## sdkconfig.defaults.esparagus-audio-brick
```kconfig
# Esparagus Audio Brick defaults
CONFIG_BOARD_ESPARAGUS_AUDIO_BRICK=y
CONFIG_ESPTOOLPY_FLASHSIZE_8MB=y
CONFIG_ESPTOOLPY_FLASHSIZE="8MB"
CONFIG_DAC_TAS58XX=y
CONFIG_DAC_CONTROLS_VOLUME=y

# GPIO config
CONFIG_BAT_CHANNEL=7
CONFIG_LED_STATUS_GPIO=12
CONFIG_LED_ERROR_GPIO=13
CONFIG_I2S_BCK_IO=26
CONFIG_I2S_WS_IO=25
CONFIG_I2S_DO_IO=22
CONFIG_DAC_I2C_SDA=21
CONFIG_DAC_I2C_SCL=27
CONFIG_JACK_GPIO=34
CONFIG_DACWARN_GPIO=
CONFIG_SPKFAULT_GPIO=
```

## sdkconfig.defaults.esparagus-louder-s3
```kconfig
# Louder Esparagus S3 / Louder-ESP32-S3 defaults
CONFIG_BOARD_ESPARAGUS_LOUDER_S3=y
CONFIG_ESPTOOLPY_FLASHSIZE_8MB=y
CONFIG_ESPTOOLPY_FLASHSIZE="8MB"
CONFIG_SPIRAM_MODE_OCT=y

CONFIG_DAC_TAS58XX=y
CONFIG_DAC_CONTROLS_VOLUME=y

# GPIO config
CONFIG_I2S_SCK_IO=-1
CONFIG_I2S_BCK_IO=14
CONFIG_I2S_WS_IO=15
CONFIG_I2S_DO_IO=16
CONFIG_DAC_I2C_SDA=8
CONFIG_DAC_I2C_SCL=9
CONFIG_SPKFAULT_GPIO=18
CONFIG_LED_RGB_GPIO=21

# W5500 Ethernet
#CONFIG_ETH_W5500_ENABLED=y
#CONFIG_ETH_USE_SPI_ETHERNET=y
#CONFIG_ETH_SPI_ETHERNET_W5500=y
CONFIG_SPI_CLK_GPIO=12
CONFIG_SPI_MOSI_GPIO=11
CONFIG_SPI_MISO_GPIO=13
CONFIG_ETH_W5500_CS_GPIO=10
CONFIG_ETH_W5500_INT_GPIO=6
CONFIG_ETH_W5500_RST_GPIO=5

# SPI Display
#CONFIG_DISPLAY_ENABLED=y
#CONFIG_DISPLAY_DRIVER_SH1106=y
#CONFIG_DISPLAY_BUS_SPI=y
CONFIG_DISPLAY_SPI_CLK=12
CONFIG_DISPLAY_SPI_MOSI=11
CONFIG_DISPLAY_SPI_CS=47
CONFIG_DISPLAY_SPI_DC=38
CONFIG_DISPLAY_SPI_RST=48
```

## sdkconfig.defaults.squeezeamp
```kconfig
# SqueezeAMP defaults
CONFIG_BOARD_SQUEEZEAMP=y
CONFIG_ESPTOOLPY_FLASHSIZE_8MB=y
CONFIG_ESPTOOLPY_FLASHSIZE="8MB"
CONFIG_DAC_TAS57XX=y
CONFIG_DAC_CONTROLS_VOLUME=y

# GPIO defaults
CONFIG_BAT_CHANNEL=7
CONFIG_LED_STATUS_GPIO=12
CONFIG_LED_ERROR_GPIO=13
CONFIG_LED_RGB_GPIO=-1
CONFIG_I2S_BCK_IO=33
CONFIG_I2S_WS_IO=25
CONFIG_I2S_DO_IO=32
CONFIG_DAC_I2C_SDA=27
CONFIG_DAC_I2C_SCL=26
CONFIG_JACK_GPIO=34
CONFIG_SPKFAULT_GPIO=2
CONFIG_MUTE_GPIO=14
CONFIG_MUTE_GPIO_LEVEL=0
CONFIG_SPDIF_DO_IO=15
CONFIG_I2S_VCC_IO=-1
CONFIG_I2S_GND_IO=-1

# Platform Configuration
CONFIG_LED_STATUS_BRIGHTNESS=80
CONFIG_LED_STATUS_PLAYING_STEADY=y
CONFIG_LED_STATUS_PAUSED_BLINK_MEDIUM=y
CONFIG_LED_STATUS_STANDBY_BLINK_SLOW=y
```

## sdkconfig.defaults.squeezeamp-4m
```kconfig
# SqueezeAMP 4MB flash variant overrides
CONFIG_BOARD_SQUEEZEAMP_4M=y
CONFIG_ESPTOOLPY_FLASHSIZE_4MB=y
CONFIG_ESPTOOLPY_FLASHSIZE="4MB"
CONFIG_PARTITION_TABLE_CUSTOM_FILENAME="components/boards/partitions-4m.csv"
```

## sdkconfig.defaults.waveshare-esp32s3
```kconfig
# Waveshare ESP32-S3-Touch-LCD-1.54 defaults
# Override generic board selection (loaded via sdkconfig.defaults.esp32s3)
CONFIG_BOARD_ESP32S3_GENERIC=n
CONFIG_BOARD_WAVESHARE_ESP32S3_TOUCH_LCD_154=y
CONFIG_ESPTOOLPY_FLASHSIZE_16MB=y
CONFIG_ESPTOOLPY_FLASHSIZE="16MB"
CONFIG_SPIRAM_MODE_OCT=y

# GPIO48 is the CST816S touch interrupt on this board.
CONFIG_LED_RGB_GPIO=-1

# Display — ST7789 SPI TFT (240x240)
CONFIG_DISPLAY_ENABLED=y
CONFIG_DISPLAY_DRIVER_ST7789=y
CONFIG_DISPLAY_BUS_SPI=y
CONFIG_DISPLAY_SPI_CLK=38
CONFIG_DISPLAY_SPI_MOSI=39
CONFIG_DISPLAY_SPI_CS=21
CONFIG_DISPLAY_SPI_DC=45
CONFIG_DISPLAY_SPI_RST=40
CONFIG_DISPLAY_BL_GPIO=46
CONFIG_DISPLAY_ST7789_WIDTH=240
CONFIG_DISPLAY_ST7789_HEIGHT=240
CONFIG_DISPLAY_ST7789_GAP_X=0
CONFIG_DISPLAY_ST7789_GAP_Y=35

# ES8311 DAC
CONFIG_DAC_ES8311=y

# I2S pins for ES8311 (overrides generic esp32s3 defaults)
# Signal names below are from the CODEC's perspective:
#   IO11 = ASDOUT (codec ADC out -> ESP32 in), IO12 = DSDIN (ESP32 out -> codec DAC in)
# So the ESP32's data-OUT (DAC audio) must go to the codec's DSDIN = GPIO12.
# IO8=MCLK, IO9=BCLK, IO10=LRCK, IO12=DOUT(ESP32->codec DAC)
CONFIG_I2S_SCK_IO=8
CONFIG_I2S_BCK_IO=9
CONFIG_I2S_WS_IO=10
CONFIG_I2S_DO_IO=12
CONFIG_I2S_GND_IO=-1

# Buttons: GPIO4=Volume+, GPIO0=Volume-, GPIO5=Play/Pause
CONFIG_BTN_VOLUME_UP_GPIO=4
CONFIG_BTN_VOLUME_DOWN_GPIO=0
CONFIG_BTN_PLAY_PAUSE_GPIO=5
CONFIG_BTN_PLAY_PAUSE_DOUBLE_CLICK=y

# LVGL configuration
CONFIG_LV_CONF_SKIP=y
CONFIG_LV_COLOR_DEPTH_16=y
CONFIG_LV_MEM_SIZE_KILOBYTES=64
CONFIG_LV_USE_LABEL=y
CONFIG_LV_USE_BAR=y
CONFIG_LV_USE_THEME_DEFAULT=y
CONFIG_LV_FONT_MONTSERRAT_14=y
CONFIG_LV_FONT_MONTSERRAT_16=y
CONFIG_LV_FONT_MONTSERRAT_24=y
CONFIG_LV_FONT_DEFAULT_MONTSERRAT_14=y
```

## sdkconfig.defaults.wrover
```kconfig
# Freenove ESP32 Wrover 4MB Devboard
CONFIG_BOARD_ESP32_GENERIC=y
CONFIG_ESPTOOLPY_FLASHSIZE_4MB=y
CONFIG_ESPTOOLPY_FLASHSIZE="4MB"
CONFIG_PARTITION_TABLE_CUSTOM_FILENAME="components/boards/partitions-4m.csv"

# GPIO defaults
CONFIG_I2S_BCK_IO=33
CONFIG_I2S_WS_IO=25
CONFIG_I2S_DO_IO=32
CONFIG_DAC_I2C_SDA=-1
CONFIG_DAC_I2C_SCL=-1
CONFIG_SPDIF_DO_IO=-1
CONFIG_DISPLAY_ENABLED=y
CONFIG_DISPLAY_I2C_SDA=13
CONFIG_DISPLAY_I2C_SCL=14

# Platform Configuration
CONFIG_LED_STATUS_BRIGHTNESS=80
CONFIG_LED_STATUS_PLAYING_STEADY=y
CONFIG_LED_STATUS_PAUSED_BLINK_MEDIUM=y
CONFIG_LED_STATUS_STANDBY_BLINK_SLOW=y
```
