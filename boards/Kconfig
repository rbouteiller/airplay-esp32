## components/boards/squeezeamp/kconfig.in
```kconfig
# SqueezeAMP board-specific configuration
# Only shown when BOARD_SQUEEZEAMP or BOARD_SQUEEZEAMP_4M is selected

if BOARD_SQUEEZEAMP_COMMON

menu "Pin Configuration"

    config BAT_CHANNEL
        int "Battery Monitor GPIO"
        default 7
        help
            GPIO for battery voltage monitoring ADC channel.

    menu "LED GPIOs"
        config LED_STATUS_GPIO
            int "Status LED GPIO"
            default 12
            help
                GPIO for status LED (single color). Set to -1 to disable.

        config LED_ERROR_GPIO
            int "Error LED GPIO"
            default 13
            help
                GPIO for error LED. Set to -1 to disable.

        config LED_RGB_GPIO
            int "RGB LED GPIO (WS2812)"
            default -1
            help
                GPIO for addressable RGB LED (WS2812). Set to -1 to disable.
    endmenu

    menu "I2S Pins"
        config I2S_BCK_IO
            int "I2S Bit Clock GPIO"
            default 33
            help
                I2S Bit Clock GPIO pin to use.

        config I2S_WS_IO
            int "I2S Word Select GPIO"
            default 25
            help
                I2S Word Select GPIO pin to use.

        config I2S_DO_IO
            int "I2S Data Output GPIO"
            default 32
            help
                I2S Data Output GPIO pin to use.

        config I2S_GND_IO
            int "I2S GND GPIO"
            default -1
            help
                GPIO to provide GND to I2S DAC if powered from GPIO. Set to -1 to disable.

        config I2S_VCC_IO
            int "I2S VCC GPIO"
            default -1
            help
                GPIO to provide VCC to I2S DAC if powered from GPIO. Set to -1 to disable.
    endmenu

    menu "DAC I2C Pins"
        config DAC_I2C_SDA
            int "I2C SDA GPIO for DAC"
            default 27
            help
                I2C data GPIO pin for TAS57xx DAC control.

        config DAC_I2C_SCL
            int "I2C SCL GPIO for DAC"
            default 26
            help
                I2C clock GPIO pin for TAS57xx DAC control.
    endmenu

    menu "Control GPIOs"
        config JACK_GPIO
            int "Headphone Jack Detection GPIO"
            default 34
            help
                GPIO for headphone jack detection.

        config SPKFAULT_GPIO
            int "DAC/AMP Fault Detection GPIO"
            default 2
            help
                GPIO for speaker/amplifier fault detection.

        config MUTE_GPIO
            int "Mute GPIO"
            default 14
            help
                GPIO used to mute DAC/amplifier.

        config MUTE_GPIO_LEVEL
            int "Mute GPIO Active Level"
            default 0
            help
                Active level for mute GPIO (0=active low, 1=active high).
    endmenu

    menu "SPDIF Pins"
        config SPDIF_DO_IO
            int "SPDIF Data Output GPIO"
            default 15
            help
                GPIO for SPDIF data output.
    endmenu

endmenu

endif # BOARD_SQUEEZEAMP_COMMON
```

## components/dac/Kconfig
```kconfig
menu "DAC Configuration"

    config DAC_TAS57XX
        bool "TI TAS57xx (TAS5754/TAS5756)"
        default n
        help
            Build the TI TAS5754M / TAS5756M DAC/amplifier driver.
            The board must register it at runtime via dac_register().

    config DAC_TAS58XX
        bool "TI TAS58xx (TAS5825M)"
        default n
        help
            Build the TI TAS5825M DAC/amplifier driver.
            The board must register it at runtime via dac_register().

    config DAC_ES8311
        bool "ESS ES8311 (stereo audio codec)"
        default n
        help
            Build the ES8311 stereo audio codec driver.
            The board must register it at runtime via dac_register().

    config DAC_CONTROLS_VOLUME
        bool
        default y if DAC_TAS57XX || DAC_TAS58XX || DAC_ES8311
        help
            Hidden option. Set automatically when a hardware DAC driver is enabled.
            When true, the DAC handles volume control and software attenuation
            is skipped in the audio output path.

endmenu
```

## components/dac_es8311/Kconfig
```kconfig
if DAC_ES8311

    config ES8311_MAX_VOLUME
        int "Maximum DAC volume (dB)"
        range -60 0
        default -60
        help
            Maximum volume level in dB that corresponds to AirPlay volume 0 dB.
            The ES8311 register range is 0 dB to -95.5 dB.
            A value of -60 means AirPlay full volume maps to -60 dB on the DAC.

endif # DAC_ES8311
```

## config/sdkconfig.defaults.esp32p4
```kconfig
CONFIG_ESPTOOLPY_FLASHSIZE_16MB=y
CONFIG_ESPTOOLPY_FLASHSIZE="16MB"
CONFIG_SPIRAM=y
CONFIG_SPIRAM_MODE_OCT=y
CONFIG_ESP_WIFI_REMOTE_ENABLED=y
CONFIG_ESP_WIFI_REMOTE_IDF_SPECIFIC_ADDED=y
CONFIG_SLAVE_IDF_TARGET_ESP32C6=y
CONFIG_SLAVE_SOC_WIFI_SUPPORTED=y
CONFIG_SLAVE_SOC_WIFI_WAPI_SUPPORT=n
CONFIG_SLAVE_SOC_WIFI_CSI_SUPPORT=n
CONFIG_SLAVE_SOC_WIFI_MESH_SUPPORT=n
CONFIG_SLAVE_SOC_WIFI_LIGHT_SLEEP_CLK_WIDTH=12
CONFIG_SLAVE_SOC_WIFI_HW_TSF=y
CONFIG_SLAVE_SOC_WIFI_FTM_SUPPORT=n
CONFIG_SLAVE_FREERTOS_UNICORE=y
CONFIG_SLAVE_SOC_WIFI_GCMP_SUPPORT=n
CONFIG_SLAVE_SOC_WIFI_TXOP_SUPPORT=n
CONFIG_SLAVE_IDF_TARGET_ARCH_RISCV=y
CONFIG_SLAVE_SOC_WIFI_HE_SUPPORT=n
CONFIG_ESP_WIFI_REMOTE_LIBRARY_HOSTED=y
CONFIG_ESP_HOSTED_ENABLED=y
CONFIG_ESP_HOSTED_CP_TARGET_ESP32C6=y
CONFIG_ESP_HOSTED_PRIV_ENABLE_WIFI_OPTIONS=y
CONFIG_ESP_HOSTED_IDF_SLAVE_TARGET="esp32c6"
CONFIG_ESP_HOSTED_P4_DEV_BOARD_NONE=y
CONFIG_ESP_HOSTED_PRIV_SDIO_OPTION=y
CONFIG_ESP_HOSTED_PRIV_SPI_HD_OPTION=y
CONFIG_ESP_HOSTED_SDIO_HOST_INTERFACE=y

# GPIO defaults
CONFIG_I2S_SCK_IO=1
CONFIG_I2S_BCK_IO=4
CONFIG_I2S_WS_IO=22
CONFIG_I2S_DO_IO=5

# Hosted SDIO Configuration
CONFIG_ESP_HOSTED_SDIO_RESET_ACTIVE_HIGH=y
CONFIG_ESP_HOSTED_SDIO_OPTIMIZATION_RX_STREAMING_MODE=y
CONFIG_ESP_HOSTED_SDIO_SLOT_1=y
CONFIG_ESP_HOSTED_SDIO_SLOT=1
CONFIG_ESP_HOSTED_SDIO_4_BIT_BUS=y
CONFIG_ESP_HOSTED_SDIO_BUS_WIDTH=4
CONFIG_ESP_HOSTED_SDIO_CLOCK_FREQ_KHZ=20000
CONFIG_ESP_HOSTED_SDIO_CMD_GPIO_RANGE_MIN=0
CONFIG_ESP_HOSTED_SDIO_CMD_GPIO_RANGE_MAX=100
CONFIG_ESP_HOSTED_SDIO_CLK_GPIO_RANGE_MIN=0
CONFIG_ESP_HOSTED_SDIO_CLK_GPIO_RANGE_MAX=100
CONFIG_ESP_HOSTED_SDIO_D0_GPIO_RANGE_MIN=0
CONFIG_ESP_HOSTED_SDIO_D0_GPIO_RANGE_MAX=100
CONFIG_ESP_HOSTED_SDIO_D1_GPIO_RANGE_MIN=0
CONFIG_ESP_HOSTED_SDIO_D1_GPIO_RANGE_MAX=100
CONFIG_ESP_HOSTED_SDIO_D2_GPIO_RANGE_MIN=0
CONFIG_ESP_HOSTED_SDIO_D2_GPIO_RANGE_MAX=100
CONFIG_ESP_HOSTED_SDIO_D3_GPIO_RANGE_MIN=0
CONFIG_ESP_HOSTED_SDIO_D3_GPIO_RANGE_MAX=100
CONFIG_ESP_HOSTED_SDIO_RESET_SLAVE_GPIO_MIN=0
CONFIG_ESP_HOSTED_SDIO_RESET_SLAVE_GPIO_MAX=100
CONFIG_ESP_HOSTED_PRIV_SDIO_PIN_CMD_SLOT_1=19
CONFIG_ESP_HOSTED_PRIV_SDIO_PIN_CLK_SLOT_1=18
CONFIG_ESP_HOSTED_PRIV_SDIO_PIN_D0_SLOT_1=14
CONFIG_ESP_HOSTED_PRIV_SDIO_PIN_D1_4BIT_BUS_SLOT_1=15
CONFIG_ESP_HOSTED_PRIV_SDIO_PIN_D2_4BIT_BUS_SLOT_1=16
CONFIG_ESP_HOSTED_PRIV_SDIO_PIN_D3_4BIT_BUS_SLOT_1=17
CONFIG_ESP_HOSTED_SDIO_GPIO_RESET_SLAVE=54
CONFIG_ESP_HOSTED_SDIO_PIN_CMD=19
CONFIG_ESP_HOSTED_SDIO_PIN_CLK=18
CONFIG_ESP_HOSTED_SDIO_PIN_D0=14
CONFIG_ESP_HOSTED_SDIO_PRIV_PIN_D1_4BIT_BUS=15
CONFIG_ESP_HOSTED_SDIO_PIN_D2=16
CONFIG_ESP_HOSTED_SDIO_PIN_D3=17
CONFIG_ESP_HOSTED_SDIO_PIN_D1=15
CONFIG_ESP_HOSTED_SDIO_TX_Q_SIZE=20
CONFIG_ESP_HOSTED_SDIO_RX_Q_SIZE=20
CONFIG_ESP_HOSTED_SDIO_RESET_DELAY_MS=1500

# Partition table configuration
CONFIG_PARTITION_TABLE_CUSTOM=y
CONFIG_PARTITION_TABLE_CUSTOM_FILENAME="components/boards/partitions-16m.csv"
CONFIG_PARTITION_TABLE_FILENAME="components/boards/partitions-16m.csv"
CONFIG_PARTITION_TABLE_OFFSET=0x8000
CONFIG_PARTITION_TABLE_MD5=y
```

## config/sdkconfig.defaults.esparagus-audio-brick
```kconfig
# Esparagus Audio Brick defaults
CONFIG_BOARD_ESPARAGUS_AUDIO_BRICK=y
CONFIG_ESPTOOLPY_FLASHSIZE_8MB=y
CONFIG_ESPTOOLPY_FLASHSIZE="8MB"
CONFIG_DAC_TAS58XX=y
CONFIG_DAC_CONTROLS_VOLUME=y

# GPIO config
CONFIG_I2S_BCK_IO=26
CONFIG_I2S_WS_IO=25
CONFIG_I2S_DO_IO=22
CONFIG_DAC_I2C_SDA=21
CONFIG_DAC_I2C_SCL=27
CONFIG_DACWARN_GPIO=36
CONFIG_SPKFAULT_GPIO=39
CONFIG_LED_RGB_GPIO=12

# W5500 Ethernet
CONFIG_ETH_W5500_ENABLED=y
CONFIG_ETH_USE_SPI_ETHERNET=y
CONFIG_ETH_SPI_ETHERNET_W5500=y
CONFIG_SPI_CLK_GPIO=18
CONFIG_SPI_MOSI_GPIO=23
CONFIG_SPI_MISO_GPIO=19
CONFIG_ETH_W5500_CS_GPIO=5
CONFIG_ETH_W5500_INT_GPIO=35
CONFIG_ETH_W5500_RST_GPIO=14


# SPI Display
CONFIG_DISPLAY_ENABLED=y
CONFIG_DISPLAY_DRIVER_SH1106=y
CONFIG_DISPLAY_BUS_SPI=y
CONFIG_DISPLAY_SPI_CLK=18
CONFIG_DISPLAY_SPI_MOSI=23
CONFIG_DISPLAY_SPI_CS=15
CONFIG_DISPLAY_SPI_DC=4
CONFIG_DISPLAY_SPI_RST=32
```

## config/sdkconfig.defaults.esparagus-louder
```kconfig
# Louder Esparagus / Louder-ESP32 defaults
CONFIG_BOARD_ESPARAGUS_LOUDER=y
CONFIG_ESPTOOLPY_FLASHSIZE_8MB=y
CONFIG_ESPTOOLPY_FLASHSIZE="8MB"
CONFIG_DAC_TAS58XX=y
CONFIG_DAC_CONTROLS_VOLUME=y

# GPIO config
CONFIG_I2S_BCK_IO=26
CONFIG_I2S_WS_IO=25
CONFIG_I2S_DO_IO=22
CONFIG_DAC_I2C_SDA=21
CONFIG_DAC_I2C_SCL=27
CONFIG_SPKFAULT_GPIO=34
CONFIG_LED_RGB_GPIO=12

# W5500 Ethernet
CONFIG_ETH_W5500_ENABLED=y
CONFIG_ETH_USE_SPI_ETHERNET=y
CONFIG_ETH_SPI_ETHERNET_W5500=y
CONFIG_SPI_CLK_GPIO=18
CONFIG_SPI_MOSI_GPIO=23
CONFIG_SPI_MISO_GPIO=19
CONFIG_ETH_W5500_CS_GPIO=5
CONFIG_ETH_W5500_INT_GPIO=35
CONFIG_ETH_W5500_RST_GPIO=14

# SPI Display
CONFIG_DISPLAY_SPI_CS=15
CONFIG_DISPLAY_SPI_DC=4
CONFIG_DISPLAY_SPI_RST=32
```

## sdkconfig.defaults.bt
```kconfig
# Bluetooth A2DP Sink defaults (ESP32 Classic BT only)
# Include this in sdkconfig for boards that support Classic Bluetooth.
# These options are ignored on ESP32-S3/C3/etc which lack Classic BT.
#
# To enable: Component config → Bluetooth → then these are set automatically.
# The A2DP_SINK_ENABLED option appears under "Airplay ESP Configuration → Bluetooth A2DP Sink".

CONFIG_BT_ENABLED=y
CONFIG_BTDM_CTRL_MODE_BR_EDR_ONLY=y
CONFIG_BT_BLUEDROID_ENABLED=y
CONFIG_BT_CLASSIC_ENABLED=y
CONFIG_BT_A2DP_ENABLE=y
CONFIG_A2DP_SINK_ENABLED=y
CONFIG_ESP_COEX_SW_COEXIST_ENABLE=y

# Security Setup
# SSP requires a screen on the device to show the code
CONFIG_BT_SSP_ENABLED=n
CONFIG_BT_PIN_CODE=05032026


# Allow Bluedroid to allocate from SPIRAM first, freeing internal DRAM for
# timers, DMA buffers and WiFi.  Fixes osi_alarm_new OOM crash when WiFi +
# Classic BT are both active.
CONFIG_BT_ALLOCATION_FROM_SPIRAM_FIRST=y

# Reduce WiFi buffer pressure — AirPlay is stopped while BT is streaming,
# so lower counts are safe and recover ~20 KB of internal DRAM.
CONFIG_ESP_WIFI_STATIC_RX_BUFFER_NUM=6
CONFIG_ESP_WIFI_DYNAMIC_RX_BUFFER_NUM=16
CONFIG_ESP_WIFI_DYNAMIC_TX_BUFFER_NUM=16

# Bluedroid creates many software timers; the default queue of 10 is
# borderline.  Increase to avoid commands backing up.
CONFIG_FREERTOS_TIMER_QUEUE_LENGTH=16

# Reduce IRAM usage: WiFi ISR optimisations moved to flash (saves ~12 KB)
CONFIG_ESP_WIFI_IRAM_OPT=n
CONFIG_ESP_WIFI_RX_IRAM_OPT=n

# Compiler optimization — use size optimization to reduce IRAM pressure
# (especially important when BT is enabled on ESP32)
CONFIG_COMPILER_OPTIMIZATION_SIZE=y

# Reduce IRAM usage: move non-critical code to flash
CONFIG_FREERTOS_PLACE_FUNCTIONS_INTO_FLASH=y
CONFIG_RINGBUF_PLACE_FUNCTIONS_INTO_FLASH=y
CONFIG_BTDM_CTRL_HLI=n
CONFIG_HEAP_PLACE_FUNCTION_INTO_FLASH=y
```

## sdkconfig.defaults.esp32
```kconfig
# ESP32 target defaults - default to SqueezeAMP board
CONFIG_BOARD_SQUEEZEAMP=y
CONFIG_ESPTOOLPY_FLASHSIZE_8MB=y
CONFIG_ESPTOOLPY_FLASHSIZE="8MB"
```

## sdkconfig.defaults.esp32s2
```kconfig
# =============================================================================
# ESP32-S2 TARGET AND FLASH LAYOUT
# =============================================================================
# Default to ESP32-S2 Generic board profile.
CONFIG_BOARD_ESP32S2_GENERIC=y
CONFIG_ESPTOOLPY_FLASHSIZE_4MB=y
CONFIG_ESPTOOLPY_FLASHSIZE="4MB"

# Use smaller partition table for 4MB flash
CONFIG_PARTITION_TABLE_CUSTOM_FILENAME="components/boards/partitions-4m.csv"

# =============================================================================
# ESP32-S2 MEMORY OPTIMIZATIONS
# =============================================================================
# ESP32-S2 has ~320KB DRAM (vs 520KB on ESP32) - memory optimization is critical
# Binary Size: ~1.3 MB, Free: ~32% of app partition (plenty of room for updates)

# Cache Configuration: Balance between memory and performance
# Default: 8KB I-cache + 8KB D-cache leaves ~304KB for app/heap
# For maximum memory: change D-cache to 0KB (if using SPIRAM) or reduce I-cache
# For maximum performance: change both to 16KB (costs ~16KB more DRAM)
CONFIG_ESP32S2_INSTRUCTION_CACHE_8KB=y
CONFIG_ESP32S2_DATA_CACHE_8KB=y

# =============================================================================
# WIFI/LWIP TUNING FOR ESP32-S2
# =============================================================================
# WiFi buffer optimization
# RX BA window must be ≤ 2 × STATIC_RX_BUFFER_NUM
CONFIG_ESP_WIFI_RX_BA_WIN=12
CONFIG_LWIP_TCP_WND_DEFAULT=34816
CONFIG_LWIP_TCP_SND_BUF_DEFAULT=18432
CONFIG_ESP_WIFI_IRAM_OPT=y
CONFIG_ESP_WIFI_RX_IRAM_OPT=y

# lwIP stack size optimization
CONFIG_LWIP_TCPIP_RECVMBOX_SIZE=64
CONFIG_LWIP_UDP_RECVMBOX_SIZE=32
CONFIG_LWIP_TCP_RECVMBOX_SIZE=32

# =============================================================================
# FREERTOS AND SYSTEM HEAP TUNING
# =============================================================================
# FreeRTOS single-core optimizations
CONFIG_FREERTOS_UNICORE=y
CONFIG_FREERTOS_OPTIMIZED_SCHEDULER=y

# Reduce idle task stack from default 1536 to save DRAM
# Default is 1536 bytes (too much for single-core), 1024 is sufficient
# Can reduce further to 768 if needed, but watch for stack overflow warnings
CONFIG_FREERTOS_IDLE_TASK_STACKSIZE=1024

# Use RTC Fast Memory as heap (adds ~8KB to available heap)
CONFIG_ESP_SYSTEM_ALLOW_RTC_FAST_MEM_AS_HEAP=y

# Increase main task stack if needed (audio/network operations)
CONFIG_ESP_MAIN_TASK_STACK_SIZE=3072

# =============================================================================
# CONSOLE/USB
# =============================================================================
# USB settings
CONFIG_ESP_CONSOLE_USB_CDC=y

# ESP32-S2 is single-core and has less DRAM than ESP32/S3
# Use SPIRAM if available on the board
# CONFIG_SPIRAM=y

# =============================================================================
# USB Audio Class defaults for the current usb_device_uac integration.
# Keep both streams stereo at 48 kHz so the UAC descriptors, feedback,
# and AirPlay USB backend all use the same resampled output rate.
CONFIG_UAC_SPEAKER_CHANNEL_NUM=2
CONFIG_UAC_MIC_CHANNEL_NUM=2
CONFIG_UAC_SAMPLE_RATE=48000

# =============================================================================
# LED Behavior Configuration
CONFIG_LED_STATUS_PLAYING_VU=y
CONFIG_LED_STATUS_PAUSED_BLINK_SLOW=y
CONFIG_LED_STATUS_STANDBY_OFF=y

# LED inversion (active-low logic)
CONFIG_LED_STATUS_INVERT=n
CONFIG_LED_ERROR_INVERT=n

# =============================================================================
# GPIO defaults (adjust for your board - ESP32-S2 has 47 GPIO pins)
CONFIG_LED_STATUS_GPIO=15
CONFIG_I2S_SCK_IO=35
CONFIG_I2S_BCK_IO=33
CONFIG_I2S_WS_IO=16
CONFIG_I2S_DO_IO=18

# ST7789 TFT display support is not enabled by default.
# The display is optional hardware — enabling it configures specific SPI
# GPIO pins which may conflict with other peripherals on your board.
# To enable, add the following to your own sdkconfig.defaults.esp32s2
# or run: idf.py menuconfig -> Display Configuration
```
