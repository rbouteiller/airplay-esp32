## boards/Kconfig
```kconfig
menu "Board Selection"

choice BOARD_TYPE
    prompt "Target Board"
    default BOARD_ESP32S3_GENERIC if IDF_TARGET_ESP32S3
    default BOARD_SQUEEZEAMP if IDF_TARGET_ESP32
    help
        Select the target hardware board.

config BOARD_SQUEEZEAMP
    bool "SqueezeAMP (8MB flash)"
    depends on IDF_TARGET_ESP32
    help
        SqueezeAMP board with TAS5756 DAC, 8MB flash, 8MB PSRAM.

config BOARD_SQUEEZEAMP_4M
    bool "SqueezeAMP (4MB flash)"
    depends on IDF_TARGET_ESP32
    help
        SqueezeAMP board with TAS5756 DAC, 4MB flash, 8MB PSRAM.

config BOARD_ESP32S3_GENERIC
    bool "ESP32-S3 Generic"
    depends on IDF_TARGET_ESP32S3
    help
        Generic ESP32-S3 development board with external I2S DAC.

endchoice

# Hidden config to detect any SqueezeAMP variant (for shared features)
config BOARD_SQUEEZEAMP_COMMON
    bool
    default y if BOARD_SQUEEZEAMP || BOARD_SQUEEZEAMP_4M

endmenu

# Source per-board Kconfig files for pin configuration
rsource "squeezeamp/Kconfig"
rsource "esp32s3-generic/Kconfig"

# Source shared configuration (LED behaviors, WiFi, etc.)
rsource "Kconfig.common"
```

## boards/esp32s3-generic/Kconfig
```kconfig
# ESP32-S3 Generic board pin configuration
# This file is sourced by boards/Kconfig when BOARD_ESP32S3_GENERIC is selected

if BOARD_ESP32S3_GENERIC

menu "ESP32-S3 Generic Pin Configuration"

    config BAT_CHANNEL
        int "Battery Monitor GPIO"
        default -1
        help
            GPIO for battery voltage monitoring ADC channel. Set to -1 to disable.

    menu "LED GPIOs"
        config LED_STATUS_GPIO
            int "Status LED GPIO"
            default -1
            help
                GPIO for status LED (single color). Set to -1 to disable.

        config LED_ERROR_GPIO
            int "Error LED GPIO"
            default -1
            help
                GPIO for error LED. Set to -1 to disable.

        config LED_RGB_GPIO
            int "RGB LED GPIO (WS2812)"
            default 48
            help
                GPIO for addressable RGB LED (WS2812). Set to -1 to disable.
    endmenu

    menu "I2S Pins"
        config I2S_BCK_IO
            int "I2S Bit Clock GPIO"
            default 11
            help
                I2S Bit Clock gpio pin to use.

        config I2S_WS_IO
            int "I2S Word Select GPIO"
            default 13
            help
                I2S Word Select gpio pin to use.

        config I2S_DO_IO
            int "I2S Data Output GPIO"
            default 12
            help
                I2S data output gpio pin to use.
    endmenu

    menu "DAC I2C Pins (optional)"
        config DAC_I2C_SDA
            int "I2C SDA GPIO for DAC"
            default -1
            help
                I2C data gpio pin for DAC control. Set to -1 if not used.

        config DAC_I2C_SCL
            int "I2C SCL GPIO for DAC"
            default -1
            help
                I2C clock gpio pin for DAC control. Set to -1 if not used.
    endmenu

    menu "Control GPIOs (optional)"
        config JACK_GPIO
            int "Headphone Jack Detection GPIO"
            default -1
            help
                GPIO for headphone jack detection. Set to -1 to disable.

        config SPKFAULT_GPIO
            int "DAC/AMP Fault Detection GPIO"
            default -1
            help
                GPIO for speaker fault detection. Set to -1 to disable.

        config MUTE_GPIO
            int "Mute GPIO"
            default -1
            help
                GPIO used to mute DAC. Set to -1 to disable.

        config MUTE_GPIO_LEVEL
            int "Mute GPIO Active Level"
            default -1
            help
                Active level for mute GPIO (0 or 1). Set to -1 if not used.
    endmenu

    menu "SPDIF Pins (optional)"
        config SPDIF_BCK_IO
            int "SPDIF Bit Clock GPIO"
            default 11
            help
                Must be set as SPDIF re-uses I2S but only needs DO.

        config SPDIF_WS_IO
            int "SPDIF Word Select GPIO"
            default 13
            help
                Must be set as SPDIF re-uses I2S but only needs DO.

        config SPDIF_DO_IO
            int "SPDIF Data Output GPIO"
            default -1
            help
                I2S data output for SPDIF. Set to -1 to disable.
    endmenu

endmenu

endif # BOARD_ESP32S3_GENERIC
```

## boards/esp32s3-generic/sdkconfig.defaults
```kconfig
# ESP32-S3 Generic board defaults
CONFIG_BOARD_ESP32S3_GENERIC=y
CONFIG_IDF_TARGET="esp32s3"
CONFIG_ESPTOOLPY_FLASHSIZE_16MB=y
CONFIG_ESPTOOLPY_FLASHSIZE="16MB"
CONFIG_SPIRAM_MODE_OCT=y
```

## boards/squeezeamp-4m/sdkconfig.defaults
```kconfig
# SqueezeAMP (4MB flash) board defaults
CONFIG_BOARD_SQUEEZEAMP_4M=y
CONFIG_IDF_TARGET="esp32"
CONFIG_ESPTOOLPY_FLASHSIZE_4MB=y
CONFIG_ESPTOOLPY_FLASHSIZE="4MB"
```

## boards/squeezeamp/Kconfig
```kconfig
# SqueezeAMP board pin configuration
# This file is sourced by boards/Kconfig for all SqueezeAMP variants

if BOARD_SQUEEZEAMP_COMMON

menu "SqueezeAMP Pin Configuration"

    config BAT_CHANNEL
        int "Battery Monitor GPIO"
        default 7
        help
            GPIO for battery voltage monitoring ADC channel.

    menu "LED GPIOs"
        config LED_STATUS_GPIO
            int "Status LED GPIO"
            default 12
            help
                GPIO for status LED (single color). Set to -1 to disable.

        config LED_ERROR_GPIO
            int "Error LED GPIO"
            default 13
            help
                GPIO for error LED. Set to -1 to disable.

        config LED_RGB_GPIO
            int "RGB LED GPIO (WS2812)"
            default -1
            help
                GPIO for addressable RGB LED (WS2812). Set to -1 to disable.
    endmenu

    menu "I2S Pins"
        config I2S_BCK_IO
            int "I2S Bit Clock GPIO"
            default 33
            help
                I2S Bit Clock gpio pin to use.

        config I2S_WS_IO
            int "I2S Word Select GPIO"
            default 25
            help
                I2S Word Select gpio pin to use.

        config I2S_DO_IO
            int "I2S Data Output GPIO"
            default 32
            help
                I2S data output gpio pin to use.
    endmenu

    menu "DAC I2C Pins"
        config DAC_I2C_SDA
            int "I2C SDA GPIO for DAC"
            default 27
            help
                I2C data gpio pin to use with TAS57xx DAC.

        config DAC_I2C_SCL
            int "I2C SCL GPIO for DAC"
            default 26
            help
                I2C clock gpio pin to use with TAS57xx DAC.
    endmenu

    menu "Control GPIOs"
        config JACK_GPIO
            int "Headphone Jack Detection GPIO"
            default 34
            help
                GPIO for headphone jack detection.

        config SPKFAULT_GPIO
            int "DAC/AMP Fault Detection GPIO"
            default 2
            help
                GPIO for speaker fault detection.

        config MUTE_GPIO
            int "Mute GPIO"
            default 14
            help
                GPIO used to mute DAC.

        config MUTE_GPIO_LEVEL
            int "Mute GPIO Active Level"
            default 0
            help
                Active level for mute GPIO (0 or 1).
    endmenu

    menu "SPDIF Pins"
        config SPDIF_BCK_IO
            int "SPDIF Bit Clock GPIO"
            default 33
            help
                Must be set as SPDIF re-uses I2S but only needs DO.
                Recommendation: set to I2S Bit clock value.

        config SPDIF_WS_IO
            int "SPDIF Word Select GPIO"
            default 25
            help
                Must be set as SPDIF re-uses I2S but only needs DO.
                Recommendation: set to I2S Word select value.

        config SPDIF_DO_IO
            int "SPDIF Data Output GPIO"
            default 15
            help
                I2S data output IO use to simulate SPDIF.
    endmenu

endmenu

endif # BOARD_SQUEEZEAMP_COMMON
```

## boards/squeezeamp/sdkconfig.defaults
```kconfig
# SqueezeAMP (8MB flash) board defaults
CONFIG_BOARD_SQUEEZEAMP=y
CONFIG_IDF_TARGET="esp32"
CONFIG_ESPTOOLPY_FLASHSIZE_8MB=y
CONFIG_ESPTOOLPY_FLASHSIZE="8MB"
```

## components/boards/Kconfig.common
```kconfig
menu "LED Configuration"
    config LED_STATUS_BRIGHTNESS
        int "Status LED brightness (0-255)"
        range 0 255
        default 80
        help
            Brightness level for the status LED (0=off, 255=max).

    menu "Status LED Behavior"
        choice LED_STATUS_ON_PLAYING
            prompt "Status LED when playing"
            default LED_STATUS_PLAYING_STEADY

            config LED_STATUS_PLAYING_STEADY
                bool "Steady"
            config LED_STATUS_PLAYING_BLINK_FAST
                bool "Blink fast"
            config LED_STATUS_PLAYING_VU
                bool "VU meter"
        endchoice

        choice LED_STATUS_ON_PAUSED
            prompt "Status LED when paused"
            default LED_STATUS_PAUSED_BLINK_MEDIUM

            config LED_STATUS_PAUSED_OFF
                bool "Off"
            config LED_STATUS_PAUSED_STEADY
                bool "Steady"
            config LED_STATUS_PAUSED_BLINK_SLOW
                bool "Blink slow"
            config LED_STATUS_PAUSED_BLINK_MEDIUM
                bool "Blink medium"
        endchoice

        choice LED_STATUS_ON_STANDBY
            prompt "Status LED when standby"
            default LED_STATUS_STANDBY_BLINK_SLOW

            config LED_STATUS_STANDBY_OFF
                bool "Off"
            config LED_STATUS_STANDBY_BLINK_SLOW
                bool "Blink slow"
            config LED_STATUS_STANDBY_BLINK_MEDIUM
                bool "Blink medium"
        endchoice
    endmenu

    menu "RGB LED Behavior"
        choice LED_RGB_ON_PLAYING
            prompt "RGB LED when playing"
            default LED_RGB_PLAYING_VU

            config LED_RGB_PLAYING_OFF
                bool "Off"
            config LED_RGB_PLAYING_STEADY
                bool "Steady color"
            config LED_RGB_PLAYING_VU
                bool "VU meter"
        endchoice

        choice LED_RGB_ON_PAUSED
            prompt "RGB LED when paused"
            default LED_RGB_PAUSED_STEADY

            config LED_RGB_PAUSED_OFF
                bool "Off"
            config LED_RGB_PAUSED_STEADY
                bool "Steady color"
        endchoice

        choice LED_RGB_ON_STANDBY
            prompt "RGB LED when standby"
            default LED_RGB_STANDBY_OFF

            config LED_RGB_STANDBY_OFF
                bool "Off"
            config LED_RGB_STANDBY_STEADY
                bool "Steady color"
        endchoice

        config LED_RGB_COLOR_PAUSED
            hex "RGB color when paused (hex)"
            default 0x000033
            help
                RGB color in hex (0xRRGGBB) for paused state.

        config LED_RGB_COLOR_STANDBY
            hex "RGB color when standby (hex)"
            default 0x001100
            help
                RGB color in hex (0xRRGGBB) for standby state.
    endmenu
endmenu
```
